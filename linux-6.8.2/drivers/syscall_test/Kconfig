## linux-6.8.2/drivers/syscall_test/Kconfig
```kconfig
config SYSCALL_TEST
    tristate "Custom Syscalls Module"
    default y
    help
      This option enables the custom syscalls kernel module.
```
